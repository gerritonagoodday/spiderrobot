/***********************************************
 * ep29.cpp
 * 2.9 inch E-Paper Driver
 * rev 1 - shabaz - December 2017
 * free for all non-commercial use
 *
 ***********************************************/

#include "mbed.h"
#include "ep29.h"

// Definitions

// these constants are taken from Waveshare source code:
#define DRIVER_OUT_CTRL                    0x01
#define BOOST_SOFT_START_CTRL              0x0c
#define GATE_SCAN_START_POS                0x0f
#define DEEP_SLEEP                         0x10
#define DATA_ENTRY_MODE_SET                0x11
#define SW_RESET                           0x12
#define TEMP_SENSOR_CTRL                   0x1a
#define MASTER_ACTIVATION                  0x20
#define DISPLAY_UPDATE_CTRL_1              0x21
#define DISPLAY_UPDATE_CTRL_2              0x22
#define WRITE_RAM                          0x24
#define WRITE_VCOM_REG                     0x2c
#define WRITE_LUT_REG                      0x32
#define SET_DUMMY_LINE_PERIOD              0x3a
#define SET_GATE_TIME                      0x3b
#define BORDER_WAVEFORM_CTRL               0x3c
#define SET_RAM_X_ADDRESS_START_END_POS    0x44
#define SET_RAM_Y_ADDRESS_START_END_POS    0x45
#define SET_RAM_X_ADDRESS_CTR              0x4e
#define SET_RAM_Y_ADDRESS_CTR              0x4f
#define TERM_FRAME_READ_WRITE              0xff

#define EP_RST_LOW ep_rst=0
#define EP_RST_HIGH ep_rst=1
#define EP_DC_LOW ep_dc=0
#define EP_DC_HIGH ep_dc=1
#define EP_DC_CMD ep_dc=0
#define EP_DC_DATA ep_dc=1
#define EP_CS_LOW ep_cs=0
#define EP_CS_HIGH ep_cs=1
#define EP_BUSY (ep_busy.read()==1)
#define EP_NOT_BUSY (ep_busy.read()==0)

// Constants
// The array here is taken from http://paulbourke.net/dataformats/hershey/

const int8_t simplex[95][112] = {
    0,16, /* Ascii 32 */
   -1,-1,-1,-1,-1,-1,-1,-1,-1,-1,-1,-1,-1,-1,-1,-1,-1,-1,-1,-1,-1,-1,-1,
   -1,-1,-1,-1,-1,-1,-1,-1,-1,-1,-1,-1,-1,-1,-1,-1,-1,-1,-1,-1,-1,-1,-1,
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   -1,-1,-1,-1,-1,-1,-1,-1,-1,-1,-1,-1,-1,-1,-1,-1,-1,-1,
};



// Extern variables

// Global variables
// Hardware Input/Output
SPI ep_spi(PTD2, PTD3, PTD1); // mosi, miso, sclk
DigitalOut ep_cs(PTD7);
DigitalOut ep_dc(PTD6);
DigitalOut ep_rst(PTA17);
DigitalIn ep_busy(PTA16);

// Function prototypes
void ep_blob(unsigned char* frame, int x, int y, unsigned char col);

// Functions
void ep_spi_init(void)
{
    EP_RST_HIGH;
    EP_CS_HIGH;
    ep_spi.format(8,0);
}

void ep_reset(void)
{
    EP_RST_LOW;
    wait(0.2);
    EP_RST_HIGH;
    wait(0.2);
}

void ep_cmd(unsigned char cmd)
{
    EP_DC_CMD;
    EP_CS_LOW;
    ep_spi.write(cmd);
    EP_CS_HIGH;
}

void ep_data(unsigned char data)
{
    EP_DC_DATA;
    EP_CS_LOW;
    ep_spi.write(data);
    EP_CS_HIGH;
}

void ep_wait(void)
{
    while(EP_BUSY);
    wait(0.1);
}

void ep_sleep(void)
{
    ep_cmd(DEEP_SLEEP);
    ep_wait();
}

void
ep_init(unsigned char* lut)
{
    int i;
    unsigned char* lutptr=(unsigned char*)lut;
    ep_reset();
    ep_cmd(DRIVER_OUT_CTRL);
    ep_data((EP_HEIGHT-1)&0xff);
    ep_data(((EP_HEIGHT-1)>>8)&0xff);
    ep_data(0x00);
    ep_cmd(BOOST_SOFT_START_CTRL);
    ep_data(0xd7);
    ep_data(0xd6);
    ep_data(0x9d);
    ep_cmd(WRITE_VCOM_REG);
    ep_data(0xa8);
    ep_cmd(SET_DUMMY_LINE_PERIOD);
    ep_data(0x1a);
    ep_cmd(SET_GATE_TIME);
    ep_data(0x08);
    ep_cmd(DATA_ENTRY_MODE_SET);
    ep_data(0x03);
    ep_cmd(WRITE_LUT_REG);
    for (i=0; i<30; i++)
    {
        ep_data(*lutptr);
        lutptr++;   
    }
}

void
ep_memptr(int x, int y)
{
    ep_cmd(SET_RAM_X_ADDRESS_CTR);
    ep_data((x>>3) & 0xff);
    ep_cmd(SET_RAM_Y_ADDRESS_CTR);
    ep_data(y & 0xff);
    ep_data((y>>8) & 0xff);
    ep_wait();
}

void
ep_memarea(int xs, int ys, int xf, int yf)
{
    ep_cmd(SET_RAM_X_ADDRESS_START_END_POS);
    ep_data((xs>>3) & 0xff);
    ep_data((xf>>3) & 0xff);
    ep_cmd(SET_RAM_Y_ADDRESS_START_END_POS);
    ep_data(ys & 0xff);
    ep_data((ys>>8) & 0xff);
    ep_data(yf & 0xff);
    ep_data((yf>>8) & 0xff);
}

void
ep_displayframe(void)
{
    ep_cmd(DISPLAY_UPDATE_CTRL_2);
    ep_data(0xc4);
    ep_cmd(MASTER_ACTIVATION);
    ep_cmd(TERM_FRAME_READ_WRITE);
    ep_wait();
}

void
ep_clearframe(unsigned char col8=ALL_WHITE)
{
    int i;
    ep_memarea(0,0, EP_WIDTH-1, EP_HEIGHT-1);
    ep_memptr(0,0);
    ep_cmd(WRITE_RAM);
    for (i=0; i<EP_FRAMEMEMSIZE; i++)
    {
        ep_data(col8);
    }
}

void
ep_setframe(unsigned char* frame, int x, int y, int width, int height)
{
    int xf, yf;
    int xx, yy;
    int width8;
    
    x=x & 0xf8;
    width=width & 0xf8;
    width8=width/8;
    xf=x+width-1;
    yf=y+height-1;
    ep_memarea(x,y, xf,yf);
    ep_memptr(x,y);
    ep_cmd(WRITE_RAM);
    for (yy=0; yy<height; yy++)
    {
        for (xx=0; xx<width8; xx++)
        {
            ep_data(frame[xx+yy*width8]);
        }
    } 
    
}

void
ep_plot_raw(unsigned char* frame, int x, int y, unsigned char col)
{  
    if ((x<0) || (x>=EP_WIDTH) || (y<0) || (y>=EP_HEIGHT))
        return;
    switch(col)
    {
        case COL_WHITE:
            frame[(x+y*EP_WIDTH)/8] |= (0x80 >> (x%8));
            break;
        case COL_BLACK:
            frame[(x+y*EP_WIDTH)/8] &= ~(0x80 >> (x%8));
            break;
        default:
            break;
    }
}

void
ep_plot(unsigned char* frame, int x, int y, unsigned char col)
{  
    int tx, ty;
    tx=y;
    ty=x;
    
    if ((x<0) || (x>=EP_HEIGHT) || (y<0) || (y>=EP_WIDTH))
        return;
    switch(col)
    {
        case COL_WHITE:
            frame[(tx+ty*EP_WIDTH)/8] |= (0x80 >> (tx%8));
            break;
        case COL_BLACK:
            frame[(tx+ty*EP_WIDTH)/8] &= ~(0x80 >> (tx%8));
            break;
        default:
            break;
    }
}

void
ep_setbg(unsigned char* frame, unsigned char col8)
{
    int i;
    unsigned char* fptr;
    fptr=frame;
    for (i=0; i<EP_WIDTH8*EP_HEIGHT; i++)
    {
        *fptr=col8;
        fptr++;
    }
}

void
ep_line(unsigned char* frame, int x, int y, int x2, int y2, unsigned char col, char weight)
{
    int dx, dy;
    int sx, sy, err, e2;
    
    if (x>x2)
        dx=x-x2;
    else
        dx=x2-x;
    if (y>y2)
        dy=y-y2;
    else
        dy=y2-y;

    if (x<x2)
        sx=1;
    else
        sx=-1;
  
    if (y<y2)
        sy=1;
    else
        sy=-1;
        
    err=dx-dy;
 
    while(1)
    {
        ep_plot(frame, x, y, col);
        switch(weight)
        {
            case PEN_THIN:
                break;
            case PEN_MED:
                if (EP_HEIGHT-1>=x+1)
                    ep_plot(frame, x+1, y, col);
                if (0<=x-1)
                    ep_plot(frame, x-1, y, col);
                if (EP_WIDTH-1>=y+1)
                    ep_plot(frame, x, y+1, col);
                if (0<=y-1)
                    ep_plot(frame, x, y-1, col);
                break;
            case PEN_THICK:
                ep_blob(frame, x, y, col);
                break;
            default:
                break;
        }
        if ((x==x2) && (y==y2))
            break;
        e2=2*err;
        if (e2>-dy)
        {
            err=err-dy;
            x=x+/*(unsigned char)*/sx;
        }
        if ((x==x2) && (y==y2))
        { 
            ep_plot(frame, x, y, col);
            switch(weight)
            {
                case PEN_THIN:
                    break;
                case PEN_MED:
                    if (EP_HEIGHT-1>=x+1)
                        ep_plot(frame, x+1, y, col);
                    if (0<=x-1)
                        ep_plot(frame, x-1, y, col);
                    if (EP_WIDTH-1>=y+1)
                        ep_plot(frame, x, y+1, col);
                    if (0<=y-1)
                        ep_plot(frame, x, y-1, col);
                    break;
                case PEN_THICK:
                    ep_blob(frame, x, y, col);
                    break;
                default:
                    break;
            }
            break;
        }
        if (e2<dx)
        { 
            err=err+dx;
            y=y+/*(unsigned char)*/sy; 
        }
    } // end while(1)
    
}

void
ep_blob(unsigned char* frame, int x, int y, unsigned char col)
{
    ep_line(frame, x-1,y+2,  x+1,y+2, col);
    ep_line(frame, x-2,y+1,  x+2,y+1, col);
    ep_line(frame, x-2,y,  x+2,y, col);
    ep_line(frame, x-2,y-1,  x+2,y-1, col);
    ep_line(frame, x-1,y-2,  x+1,y-2, col);
}

int
ep_write_text(unsigned char* frame, char* text, int x, int y, unsigned char col,
                double xscale, double yscale, unsigned int* dy, char weight)
{
    int xx, mdy;
    int wt;
    int i, im;
    int ci=0;
    unsigned char c;
    int nv;
    int /*int8_t*/ w;
    int ipx, ipy;
    int px, py;
    int ox, oy;
    int old=0;
    int do_scale=0;
    int not_finished=1;
    mdy=0;
    
    ox=0; oy=0;
    wt=0;
    
    if ((xscale>1.01) || (xscale<1.01) || (yscale>1.01) || (yscale<1.01))
        do_scale=1;
    
    xx=x;
    while(not_finished)
    {
        c=text[ci];
        ci++;
        if (c=='\0')
            break;
        if ((c>126) || (c<32))
            continue;
        c=c-32;
        nv=simplex[c][0];
        w=simplex[c][1];
        if (w<0)
            w=0-w;
        if (nv==0)
        {
            xx=xx+w;
            wt=wt+w;
            continue;
        }
        im=2+(nv*2);
        old=0;
        for (i=2; i<im; i=i+2)
        {
            ipx=simplex[c][i];
            ipy=simplex[c][i+1];
            if (ipx>=0)
            {
                px=ipx;
            }
            else
            {
                px=0-ipx;
            }
            if (ipy>=0)
            {
                py=ipy;
            }
            else
            {
                if (py==-1)
                {
                    py=32767;
                }
                else
                {
                    py=0-ipy;
                }
            }
            
            if (do_scale)
            {
                //px=(unsigned int)(((double)ipx)*xscale);
                //py=(unsigned int)(((double)ipy)*yscale);
                px=((double)px)*xscale;
                py=((double)py)*yscale;
            }
            if ((py!=32767) && (py>mdy))
                mdy=py+1;
            if ((ipx==-1) && (ipy==-1)) // pen up
            {
                old=0;
            }
            else
            {
                if (old) // a previous point is stored in ox, oy
                {
                    if (((ox+xx)>(EP_HEIGHT-1)) || ((px+xx)>(EP_HEIGHT-1)))
                    {
                        not_finished=0;
                        break;
                    }
                    ep_line(frame, ox+xx, oy+y, px+xx, py+y, col, weight);
                    ox=px; oy=py;
                }
                else
                {
                    ox=px; oy=py;
                    old=1;
                }
            }
        }
        if (do_scale)
        {
            xx=xx+(unsigned int)(((double)w)*xscale);
            wt=wt+(unsigned int)(((double)w)*xscale);
        }
        else
        {
            xx=xx+w;
            wt=wt+w;
        }
    }

    if (dy!=NULL)
        *dy=mdy;
    return(wt+1);
}

